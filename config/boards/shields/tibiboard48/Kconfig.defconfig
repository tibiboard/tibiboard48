## config/boards/shields/tibiboard48/Kconfig.defconfig
```kconfig
if SHIELD_TIBIBOARD48_LEFT

config ZMK_KEYBOARD_NAME
    default "tibiboard48"

config ZMK_SPLIT_ROLE_CENTRAL
    default y

endif

if SHIELD_TIBIBOARD48_LEFT || SHIELD_TIBIBOARD48_RIGHT

config ZMK_SPLIT
    default y

endif
```

## config/boards/shields/tibiboard48/Kconfig.shield
```kconfig
 config SHIELD_TIBIBOARD48_LEFT
    def_bool $(shields_list_contains,tibiboard48_left)

 config SHIELD_TIBIBOARD48_RIGHT
    def_bool $(shields_list_contains,tibiboard48_right)
    
```

## config/west.yml
```yaml
manifest:
  remotes:
    - name: myzmk
      url-base: https://github.com/tibiboard
  projects:
    - name: zmk
      remote: myzmk
      revision: mykbd=1.2
      import: app/west.yml
  self:
    path: config
```
